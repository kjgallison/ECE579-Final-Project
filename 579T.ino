// Import TensorFlow stuff
#include "TensorFlowLite.h"
#include "tensorflow/lite/micro/kernels/micro_ops.h"
#include "tensorflow/lite/micro/tflite_bridge/micro_error_reporter.h"
#include "tensorflow/lite/micro/micro_interpreter.h"
#include "tensorflow/lite/micro/micro_mutable_op_resolver.h"
//#include "tensorflow/lite/version.h"

// Our model
#include "lstm_vF2_h.h"

// TFLite globals, used for compatibility with Arduino-style sketches
namespace {
  tflite::ErrorReporter* error_reporter = nullptr;
  const tflite::Model* model = nullptr;
  tflite::MicroInterpreter* interpreter = nullptr;
  TfLiteTensor* model_input = nullptr;
  TfLiteTensor* model_output = nullptr;

  // Create an area of memory to use for input, output, and other TensorFlow
  // arrays. You'll need to adjust this by combiling, running, and looking
  // for errors.
  constexpr int kTensorArenaSize = 35 * 1024;
  uint8_t tensor_arena[kTensorArenaSize];
} // namespace


float input_mat[120][5] = {-0.4530316889286041, 0.6325944662094116, -1.2668254375457764, 0.5556210875511169, -0.21407786011695862, -0.5660406351089478, 0.4580884873867035, -0.9056735038757324, 0.7837467789649963, -0.21407786011695862, -0.622545063495636, 0.40822961926460266, -0.4514824450016022,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 1.0118725299835205, 0.9589407444000244};


void setup() {
  // Wait for Serial to connect

  while(!Serial);


  // Let's make an LED vary in brightness
  // pinMode(led_pin, OUTPUT);

  // Set up logging (will report to Serial, even within TFLite functions)
  static tflite::MicroErrorReporter micro_error_reporter;
  error_reporter = &micro_error_reporter;



  // Map the model into a usable data structure
  model = tflite::GetModel(lstm_vF2_h);
  if (model->version() != TFLITE_SCHEMA_VERSION) {
    error_reporter->Report("Model version does not match Schema");
    while(1);
  }


  static tflite::MicroMutableOpResolver<7> micro_mutable_op_resolver;
  micro_mutable_op_resolver.AddQuantize();
  micro_mutable_op_resolver.AddStridedSlice();
  micro_mutable_op_resolver.AddUnidirectionalSequenceLSTM();
  micro_mutable_op_resolver.AddFullyConnected();
  micro_mutable_op_resolver.AddRelu();
  micro_mutable_op_resolver.AddTanh();
  micro_mutable_op_resolver.AddDequantize();

  // Build an interpreter to run the model
  static tflite::MicroInterpreter static_interpreter(
    model, micro_mutable_op_resolver, tensor_arena, kTensorArenaSize);
  interpreter = &static_interpreter;

  // Allocate memory from the tensor_arena for the model's tensors
  TfLiteStatus allocate_status = interpreter->AllocateTensors();
  if (allocate_status != kTfLiteOk) {
    error_reporter->Report("AllocateTensors() failed");
    while(1);
  }

  // Assign model input and output buffers (tensors) to pointers
  model_input = interpreter->input(0);
  model_output = interpreter->output(0);

  // Get information about the memory area to use for the model's input
  // Supported data types:
  // https://github.com/tensorflow/tensorflow/blob/master/tensorflow/lite/c/common.h#L226

  Serial.print("Number of dimensions: ");
  Serial.println(model_output->dims->size);
  Serial.print("Dim 1 size: ");
  Serial.println(model_output->dims->data[0]);
  Serial.print("Dim 2 size: ");
  Serial.println(model_output->dims->data[1]);
  // Serial.print("Dim 3 size: ");
  // Serial.println(model_input->dims->data[2]);
  Serial.print("Input type: ");
  Serial.println(model_input->type);

}

void loop() {
  unsigned long start_timestamp = micros();

  // Copy value to input buffer (tensor)
  //model_input->data.f[120][5] = input;

  // int input = interpreter->inputs()[0];
  // float* input_data_ptr = interpreter->typed_input_tensor<float>(input);
  for (int i = 0; i < 120; ++i) {
      for (int j = 0; j < 5; j++) {
          // *(input_data_ptr) = input_mat[i][j];
          model_input->data.f[i*5+j] = input_mat[i][j];
          // input_data_ptr++;
      }
  }

  // Run inference
  TfLiteStatus invoke_status = interpreter->Invoke();
  if (invoke_status != kTfLiteOk) {
    error_reporter->Report("Invoke failed on input: %f\n", input_mat);
  }

  // Read predicted y value from output buffer (tensor)
  float output = model_output->data.f[0];

  // Print value
  Serial.println(output);

  Serial.print("Time for inference (seconds): ");
  Serial.println((micros() - start_timestamp)/1000000);
  delay(100000);
}